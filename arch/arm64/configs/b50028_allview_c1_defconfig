## arch/arm64/configs/b50028_allview_c1_defconfig
```kconfig
CONFIG_RGK_USB_DRIVER_DISPLAY_MANUFACTURER="CD"
CONFIG_RGK_USB_DRIVER_DISPLAY_PRODUCT="ROM"
```

## arch/arm64/configs/b50048_tecno_b1_37m35_defconfig
```kconfig
CONFIG_RGK_USB_DRIVER_DISPLAY_MANUFACTURER="RGK"
CONFIG_RGK_USB_DRIVER_DISPLAY_PRODUCT="d517h_logicom"
```

## arch/arm64/configs/d5278_s2_37m35_n_defconfig
```kconfig
CONFIG_RGK_USB_DRIVER_DISPLAY_MANUFACTURER="RGK"
CONFIG_RGK_USB_DRIVER_DISPLAY_PRODUCT="d5278_s2_37m35_n"
```

## drivers/input/touchscreen/mediatek/Kconfig
```kconfig
#
# Touchscreen driver configuration
#
menuconfig INPUT_TOUCHSCREEN
	bool "Touchscreens"
	help
	  Say Y here, and a list of supported touchscreens will be displayed.
	  This option doesn't affect the kernel.

	  If unsure, say Y.

if INPUT_TOUCHSCREEN

config TOUCHSCREEN_MTK
	tristate "MediaTek Touch Panel Driver"
	default n
	help
	  Say Y here if you have MediaTek touch panel.

	  If unsure, say N.

	  To compile this dirver as a module, choose M here: the
	  module will be called.

source "drivers/input/touchscreen/mediatek/GT1151/Kconfig"


config TOUCHSCREEN_MTK_GT1151TB
	bool "GT1151 for Mediatek package"
	default n
	help
	  Say Y here if you have GT1151 touch panel.

	  If unsure, say N.

	  To compile this dirver as a module, choose M here: the
	  module will be called.

source "drivers/input/touchscreen/mediatek/GT1151TB/Kconfig"

config TOUCHSCREEN_MTK_GT928
	tristate "GT928 Touchscreen"
	help
	  Say Y here if you have Goodix GT928 touchscreen,
	  connected to your system.
	  If unsure, say N.
	  To compile this driver as a module, choose M here.

config TOUCHSCREEN_MTK_GT9XXTB_HOTKNOT
	bool "GT9XXTB hotknot for Mediatek package"
	default n
	help
	  Say Y here if you have GT9XXTB hotknot touch panel.

	  If unsure, say N.

	  To compile this dirver as a module, choose M here: the
	  module will be called.

source "drivers/input/touchscreen/mediatek/GT9XXTB_hotknot/Kconfig"

config TOUCHSCREEN_MTK_GT9XX_HOTKNOT
	bool "GT9XX hotknot for Mediatek package"
	default n
	help
	  Say Y here if you have GT9XX hotknot touch panel.

	  If unsure, say N.

	  To compile this dirver as a module, choose M here: the
	  module will be called.

source "drivers/input/touchscreen/mediatek/GT9XX_hotknot/Kconfig"

config TOUCHSCREEN_MTK_GT9XX_HOTKNOT_PHONE
	bool "GT9XX hotknot phone for Mediatek package"
	default n
	help
	  Say Y here if you have GT9XX hotknot phone touch panel.

	  If unsure, say N.

	  To compile this dirver as a module, choose M here: the
	  module will be called.

source "drivers/input/touchscreen/mediatek/GT9XX_hotknot_phone/Kconfig"

config TOUCHSCREEN_MTK_SYNAPTICS_I2C_RMI4
	tristate "Synaptics DSX I2C touchscreen"
	depends on I2C
	help
	  Say Y here if you have a Synaptics DSX I2C touchscreen
	  connected to your system.

	  If unsure, say N.

	  To compile this driver as a module, choose M here: the
	  module will be called synaptics_i2c_rmi4.

source "drivers/input/touchscreen/mediatek/synaptics_i2c_rmi4/Kconfig"

config TOUCHSCREEN_MTK_GT910
	bool "GT910 for Mediatek package"
	default n
	help
	  Say Y here if you have GT910 touch panel.

	  If unsure, say N.

	  To compile this dirver as a module, choose M here: the
	  module will be called.

source "drivers/input/touchscreen/mediatek/GT910/Kconfig"

config TOUCHSCREEN_MTK_GT9XX_HOTKNOT_SCP
	bool "GT9XX_HOTKNOT_SCP for Mediatek package"
	default n
	help
	  Say Y here if you have GT9XX_HOTKNOT_SCP touch panel.

	  If unsure, say N.

	  To compile this dirver as a module, choose M here: the
	  module will be called.

source "drivers/input/touchscreen/mediatek/GT9XX_hotknot_scp/Kconfig"

config TOUCHSCREEN_MTK_GT911
	bool "GT911 for Mediatek package"
	default n
	help
	  Say Y here if you have GT911 touch panel.

	  If unsure, say N.

	  To compile this dirver as a module, choose M here: the
	  module will be called.

source "drivers/input/touchscreen/mediatek/GT911/Kconfig"

config TOUCHSCREEN_MTK_FT6336U
	bool "FT5X0X for Mediatek package"
	default n
	help
	  Say Y here if you have FT5X0X touch panel.

	  If unsure, say N.

	  To compile this dirver as a module, choose M here: the
	  module will be called.

source "drivers/input/touchscreen/mediatek/ft6336u/Kconfig"

config TOUCHSCREEN_MTK_SYNAPTICS_3320_50
	bool "Synaptics 5.0inch for Mediatek package"
    default n

config TOUCHSCREEN_MTK_MSG2238
	bool "MSG2238 for Mediatek package"
	default n
	help
	  Say Y here if you have MSG2238 touch panel.

	  If unsure, say N.

	  To compile this dirver as a module, choose M here: the
	  module will be called.

config ENABLE_GESTURE_WAKEUP
	bool "MSG2238_B50018 ENABLE_GESTURE_WAKEUP"
	default n
	help
	  Say Y here if you have MSG2238 touch panel.

	  If unsure, say N.

	  To compile this dirver as a module, choose M here: the
	  module will be called.

config TOUCHSCREEN_MTK_GT9271TB_HOTKNOT
	bool "GT911 for Mediatek package"
	default n
	help
	  Say Y here if you have GT9271TB_HOTKNOT touch panel.

	  If unsure, say N.

	  To compile this dirver as a module, choose M here: the
	  module will be called.

source "drivers/input/touchscreen/mediatek/GT9271TB_hotknot/Kconfig"

config TOUCHSCREEN_UNIFIED_DRIVER_4
	bool "LGE Unified driver Ver4.0"
	depends on I2C
	default n
	help
	  Say Y here if you use lge unified driver ver4.0
	  if unsure, say N
	  To compile this dirver as a module, choose M here: the
	  module will be called.

config TOUCHSCREEN_LGE_MIT300
	bool "Melfas MIT-300 based on LGE Touch Core driver"
	depends on I2C && TOUCHSCREEN_UNIFIED_DRIVER_4
	default n
	help
	  Say Y here if you have a Mefas MIT-300 I2C touchscreen
	  connected to your system.
	  To compile this dirver as a module, choose M here: the
	  module will be called.

config TOUCHSCREEN_LGE_MIT300_M4
	bool "Melfas MIT-300 based on LGE Touch Core driver"
	depends on I2C && TOUCHSCREEN_UNIFIED_DRIVER_4
	default n
	help
	  Say Y here if you have a Mefas MIT-300 I2C touchscreen
	  connected to your system.
	  To compile this dirver as a module, choose M here: the
	  module will be called.

config TOUCHSCREEN_LGE_FT8707
	bool "FT8707 based on LGE Touch Core driver"
	depends on I2C && TOUCHSCREEN_UNIFIED_DRIVER_4
	default n
	help
	  Say Y here if you have a FT8707 I2C touchscreen
	  connected to your system.
	  To compile this dirver as a module, choose M here: the
	  module will be called.

config TOUCHSCREEN_MTK_FT3327
	bool "FT3427 for Mediatek package"
	default n
	help
	  Say Y here if you have FT3427 touch panel.

	  If unsure, say N.

	  To compile this dirver as a module, choose M here: the
	  module will be called.

config TOUCHSCREEN_MTK_FT3427
	bool "FT3427 for Mediatek package"
	default n
	help
	  Say Y here if you have FT3427 touch panel.

	  If unsure, say N.

	  To compile this dirver as a module, choose M here: the
	  module will be called.
	  
config TOUCHSCREEN_MTK_MSG2238_D517G
	bool "MSG2238 for Mediatek package"
	default n
	help
	  Say Y here if you have MSG2238 touch panel.

	  If unsure, say N.

	  To compile this dirver as a module, choose M here: the
	  module will be called.

config TOUCHSCREEN_MTK_MSG2238_D517H
	bool "MSG2238 for Mediatek package"
	default n
	help
	  Say Y here if you have MSG2238 touch panel.

	  If unsure, say N.

	  To compile this dirver as a module, choose M here: the
	  module will be called.

config TOUCHSCREEN_MTK_MSG2238_D517H_MMX
	bool "MSG2238 for Mediatek package"
	default n
	help
	  Say Y here if you have MSG2238 touch panel.

	  If unsure, say N.

	  To compile this dirver as a module, choose M here: the
	  module will be called.

config TOUCHSCREEN_MTK_MSG2238_D517J
	bool "MSG2238 for Mediatek package"
	default n
	help
	  Say Y here if you have MSG2238 touch panel.

	  If unsure, say N.

	  To compile this dirver as a module, choose M here: the
	  module will be called.

config TOUCHSCREEN_MTK_MSG2256A_B55016
	bool "MSG2238 for Mediatek package"
	default n
	help
	  Say Y here if you have MSG2238 touch panel.

	  If unsure, say N.

	  To compile this dirver as a module, choose M here: the
	  module will be called.

config TOUCHSCREEN_MTK_MSG2238_D517I
	bool "MSG2238 for Mediatek package"
	default n
	help
	  Say Y here if you have MSG2238 touch panel.

	  If unsure, say N.

	  To compile this dirver as a module, choose M here: the
	  module will be called.
	  
config TOUCHSCREEN_MTK_MSG2238_B50048
	bool "MSG2238 for Mediatek package"
	default n
	help
	  Say Y here if you have MSG2238 touch panel.

	  If unsure, say N.

	  To compile this dirver as a module, choose M here: the
	  module will be called.
	  
config TOUCHSCREEN_MTK_MSG2238_B50028
	bool "MSG2238 for Mediatek package"
	default n
	help
	  Say Y here if you have MSG2238 touch panel.

	  If unsure, say N.

	  To compile this dirver as a module, choose M here: the
	  module will be called.

config TOUCHSCREEN_MTK_MSG5846
	bool "MSG2238_D5178 for Mediatek package"
	default n
	help
	  Say Y here if you have MSG2238_D5178 touch panel.

	  If unsure, say N.

	  To compile this dirver as a module, choose M here: the
	  module will be called.

config TOUCHSCREEN_MTK_MSG5846_V55308
	bool "MSG2238_D5178 for Mediatek package"
	default n
	help
	  Say Y here if you have MSG2238_D5178 touch panel.

	  If unsure, say N.

	  To compile this dirver as a module, choose M here: the
	  module will be called.
source "drivers/input/touchscreen/mediatek/GT915L_V52516/Kconfig"
config TOUCHSCREEN_MTK_GT915L_V52516
	bool "GT915L for Mediatek package"
	default n
	help
	  Say Y here if you have GT915L touch panel.

	  If unsure, say N.

	  To compile this dirver as a module, choose M here: the
	  module will be called.

source "drivers/input/touchscreen/mediatek/FT3X27_V52516_S2/Kconfig"
config TOUCHSCREEN_MTK_FT3X27_V52516_S2
	bool "FT3427 for Mediatek package"
	default n
	help
	  Say Y here if you have FT3X27 touch panel.

	  If unsure, say N.

	  To compile this dirver as a module, choose M here: the
	  module will be called.

source "drivers/input/touchscreen/mediatek/FT5436_V52516/Kconfig"
config TOUCHSCREEN_MTK_FT5436_V52516
	bool "FT5436 for Mediatek package"
	default n
	help
	  Say Y here if you have GT915L touch panel.

	  If unsure, say N.

	  To compile this dirver as a module, choose M here: the
	  module will be called.
config TOUCHSCREEN_MTK_MSG2238_D5278
	bool "msg2238 d5278 touchscreen"
	default n
	help
	  Say Y here if you have a msg2238 d5278 touchscreen
	  connected to your system.
	  If unsure, say N.
	  To compile this driver as a module, choose M here: the
	  module will be called msg2238.
source "drivers/input/touchscreen/mediatek/msg2238_d5278/Kconfig"
endif
```

## drivers/input/touchscreen/mediatek/msg2238_d5278/Kconfig
```kconfig
#
# Touchscreen driver configuration
#
if TOUCHSCREEN_MTK_MSG2238

config TP_MSG2238_COMPATIBLE
        bool TP_MSG2238_COMPATIBLE
        default n
	help
          CONFIG_TP_MSG2238_COMPATIBLE
		  
config TOUCHSCREEN_MTK_MSG2238_PROXIMITY
        bool TOUCHSCREEN_MTK_MSG2238_PROXIMITY
        default n
	help
          CONFIG_TOUCHSCREEN_MTK_MSG2238_PROXIMITY
		  
endif
```

## drivers/input/touchscreen/mediatek/msg5846_v55308/Kconfig
```kconfig
#
# Touchscreen driver configuration
#
if TOUCHSCREEN_MTK_MSG5846

config TP_MSG5846_COMPATIBLE
        bool TP_MSG5846_COMPATIBLE
        default n
	help
          CONFIG_TP_MSG5846_COMPATIBLE

endif
```

## drivers/misc/mediatek/accelerometer/da2xx/Kconfig
```kconfig
config MTK_DS_DA2XX
	bool "mir3da_cust for MediaTek package"
	default n
	help
	  It support different accelerometer sensor.
          If this option is set,
	  it will support
          mir3da_cust Accelerometer.
```

## drivers/misc/mediatek/accelerometer/qma6981/Kconfig
```kconfig
config MTK_QMA6981
	bool "QMA6981 for MediaTek package"
	default n
	help
	  It support different accelerometer sensor.
          If this option is set,
	  it will support
          qma6981 Accelerometer.
```

## drivers/misc/mediatek/alsps/ltr_559als/Kconfig
```kconfig
config MTK_LTR_559
	bool "MTK_LTR_559 for MediaTek package"
	default n
	help
	It support different type sensor
	in this platform. If this option
	is set, it will support ambient
	and light sensor MTK_LTR_559.


config LTR559_PS_MEAS_RATE_LOW
	bool "USE LOW MEAS_RATE FOR PSENSOR LTR559"
	default n
	help
	Say Y here if you have ft5x0x touch panel CUST_FTS_APK_DEBUG.

	If unsure, say N.

	To compile this dirver as a module, choose M here: the
	module will be called.
```

## drivers/misc/mediatek/alsps/mn25713/Kconfig
```kconfig
config MTK_MN25713
	bool "MTK_MN25713 for MediaTek package"
	default n
	help
	It support different type sensor
	in this platform. If this option
	is set, it will support ambient
	and light sensor MTK_MN25713.
```

## drivers/misc/mediatek/fingerprint/Kconfig
```kconfig
config CUSTOM_KERNEL_FINGERPRINT
	bool "CUSTOM_KERNEL_FINGERPRINT"
	default n
	help
	  fingerprint sensor used to detect fingerprint


source "drivers/misc/mediatek/fingerprint/gx368/Kconfig"
source "drivers/misc/mediatek/fingerprint/gx368_new/Kconfig"
source "drivers/misc/mediatek/fingerprint/sw9351/Kconfig"
source "drivers/misc/mediatek/fingerprint/gf318m/Kconfig"
source "drivers/misc/mediatek/fingerprint/sw9562/Kconfig"
source "drivers/misc/mediatek/fingerprint/gf5216/Kconfig"
source "drivers/misc/mediatek/fingerprint/sw9051/Kconfig"
source "drivers/misc/mediatek/fingerprint/fps998/Kconfig"
source "drivers/misc/mediatek/fingerprint/sunwave_ree/Kconfig"
source "drivers/misc/mediatek/fingerprint/sunwave_tee/Kconfig"
```

## drivers/misc/mediatek/fingerprint/fps998/Kconfig
```kconfig
config FINGERPRINT_FPS998
	bool "FINGERPRINT_FPS998"
	default n
	help
	  use cdfinger fingerprint fps9051
```

## drivers/misc/mediatek/fingerprint/gf318m/Kconfig
```kconfig
config FINGERPRINT_GOODIX_GF318M
	bool "FINGERPRINT_GOODIX_GF318M"
	default n
	help
	  use goodix fingerprint gx358/gx368
```

## drivers/misc/mediatek/fingerprint/gx368/Kconfig
```kconfig
config FINGERPRINT_GX368
	bool "FINGERPRINT_GX368"
	default n
	help
	  use goodix fingerprint gx358/gx368

config FINGERPRINT_USING_EXT_LDO
	bool "FINGERPRINT_USING_EXT_LDO"
	default n
	help 
		if this is config,the fingerprint using ext_ldo supply 2.8v.use a gpio to control it 

config FINGERPRINT_GX368_USING_32_BIT
	bool "FINGERPRINT_GX368_USING_32_BIT"
	default n
	help 
		if this is config,the fingerprint using 32 bit driver ,else using 64 bit driver
```

## drivers/misc/mediatek/fingerprint/sunwave_tee/Kconfig
```kconfig
#menu "sunwavecorp sensor Device"

#menuconfig SUNWAVECORP
#        tristate "sunwavecorp fp sensor "
#        default y
#        ---help---
#          Say Y here for supporting sunwavecorp sensor

#if SUNWAVECORP

#choice
#	prompt "sunwavecorp sensor for"
#	default SUNWAVECORP_MT6797  

#config SUNWAVECORP_MT6797
#        bool " MT6797 with dts"
#        default y
#        ---help---
#          sunwavecorp sensor for MT6797 with dts          
#endchoice

#endif

#endmenu


config FINGERPRINT_SUNWAVE_TEE
	bool "FINGERPRINT_SUNWAVE_TEE"
	default n
	help
	  use sunwave fingerprint SUNWAVE TEE
```

## drivers/misc/mediatek/fingerprint/sw9562/Kconfig
```kconfig
#menu "sunwavecorp sensor Device"

#menuconfig SUNWAVECORP
#        tristate "sunwavecorp fp sensor "
#        default y
#        ---help---
#          Say Y here for supporting sunwavecorp sensor

#if SUNWAVECORP

#choice
#	prompt "sunwavecorp sensor for"
#	default SUNWAVECORP_MT6797  

#config SUNWAVECORP_MT6797
#        bool " MT6797 with dts"
#        default y
#        ---help---
#          sunwavecorp sensor for MT6797 with dts          
#endchoice

#endif

#endmenu


config FINGERPRINT_SW9562
	bool "FINGERPRINT_SW9562"
	default n
	help
	  use sunwave fingerprint SUNWAVE 9351

config FINGERPRINT_SW9651
	bool "FINGERPRINT_SW9651"
	default n
	help
	  use sunwave fingerprint SUNWAVE 9651
```
